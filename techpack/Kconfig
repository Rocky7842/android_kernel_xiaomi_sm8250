## techpack/Kconfig
```kconfig
menu "Tech packages"

source "techpack/data/Kconfig"

menu "Camera packages"

config TECHPACK_CAMERA_XIAOMI_NONEDXO
    bool "Xiaomi camera nonedxo"
    help
      Xiaomi camera nonedxo

config TECHPACK_CAMERA_XIAOMI_CAS
    bool "Xiaomi camera CAS"
    help
      Xiaomi camera CAS

config TECHPACK_CAMERA_XIAOMI_DXO
    bool "Xiaomi camera dxo"
    help
      Xiaomi camera dxo

config TECHPACK_CAMERA_XIAOMI_TABLET
    bool "Xiaomi camera tablet"
    help
      Xiaomi camera tablet

endmenu

endmenu
```
